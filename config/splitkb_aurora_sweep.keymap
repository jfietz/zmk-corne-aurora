/* source keypos definitions */
#include "../zmk-nodefree-config/keypos_def/keypos_36keys.h"

/* activate bluetooth */
#define CONFIG_WIRELESS 1
#define QWERTY
/* source the main keymap */
#include "base.keymap"